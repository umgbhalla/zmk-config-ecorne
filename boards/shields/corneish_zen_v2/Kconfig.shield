## boards/shields/corneish_zen_v2/Kconfig.shield
```kconfig
# No whitespace after the comma or in the keyboard name!
config SHIELD_CORNEISH_ZEN_V2_DONGLE
    def_bool $(shields_list_contains,corneish_zen_v2_dongle)
```
